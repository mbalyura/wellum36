#include "wellum36.dtsi"

/*
 * Вариант подключения: direct pin
 */

&default_transform {
	col-offset = <18>;
};

&kscan0 {
	input-gpios
		= <&pro_micro  2 (GPIO_ACTIVE_LOW | GPIO_PULL_UP)> // Y   |  17
		, <&pro_micro  4 (GPIO_ACTIVE_LOW | GPIO_PULL_UP)> // U   |  22
		, <&pro_micro  6 (GPIO_ACTIVE_LOW | GPIO_PULL_UP)> // I   |  100
		, <&pro_micro  8 (GPIO_ACTIVE_LOW | GPIO_PULL_UP)> // O   |  104
		, <&pro_micro  1 (GPIO_ACTIVE_LOW | GPIO_PULL_UP)> // P   |  6

		, <&pro_micro  3 (GPIO_ACTIVE_LOW | GPIO_PULL_UP)> // H   |  20
		, <&pro_micro  5 (GPIO_ACTIVE_LOW | GPIO_PULL_UP)> // J   |  24
		, <&pro_micro  7 (GPIO_ACTIVE_LOW | GPIO_PULL_UP)> // K   |  11
		, <&pro_micro  9 (GPIO_ACTIVE_LOW | GPIO_PULL_UP)> // L   |  106
		, <&pro_micro 21 (GPIO_ACTIVE_LOW | GPIO_PULL_UP)> // ;   |  31

		, <&pro_micro 15 (GPIO_ACTIVE_LOW | GPIO_PULL_UP)> // N   |  113
		, <&pro_micro 19 (GPIO_ACTIVE_LOW | GPIO_PULL_UP)> // M   |  2
		, <&pro_micro 10 (GPIO_ACTIVE_LOW | GPIO_PULL_UP)> // ,   |  9
		, <&pro_micro 20 (GPIO_ACTIVE_LOW | GPIO_PULL_UP)> // .   |  29
		, <&pro_micro  0 (GPIO_ACTIVE_LOW | GPIO_PULL_UP)> // /   |  8

		, <&pro_micro 18 (GPIO_ACTIVE_LOW | GPIO_PULL_UP)> // )   |  115
		, <&pro_micro 14 (GPIO_ACTIVE_LOW | GPIO_PULL_UP)> // }   |  111
		, <&pro_micro 16 (GPIO_ACTIVE_LOW | GPIO_PULL_UP)> // ]   |  10
		;
};
