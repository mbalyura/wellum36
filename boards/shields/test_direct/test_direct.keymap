/ {
    keymap {
        compatible = "zmk,keymap";
        bindings = <
            &kp A &kp B &kp C &kp D &kp E
            &kp F &kp G &kp H &kp I &kp J
            &kp K &kp L &kp M &kp N &kp O
            &kp P &kp Q &kp R &kp S &kp T
        >;
    };
};
